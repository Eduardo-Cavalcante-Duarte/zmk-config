#include <dt-bindings/zmk/matrix_transform.h>

/ {
    default_transform: matrix_transform {
        compatible = "zmk,matrix-transform";
        columns = <14>;
        rows = <6>;
        map = <>;
    };

    chosen {
        zmk,matrix-transform = &default_transform;
    };
};
