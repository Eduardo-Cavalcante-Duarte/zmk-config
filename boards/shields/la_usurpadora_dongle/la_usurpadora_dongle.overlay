#include <dt-bindings/zmk/matrix_transform.h>
#include "la_usurpadora_dongle.dtsi"

/ {
    chosen {
        zmk,kscan = &mock_kscan;
        zmk,matrix-transform = &default_transform;
    };

    mock_kscan: kscan {
        compatible = "zmk,kscan-mock";
        columns = <14>; 
        rows = <6>;
        events = <0>;
    };
};
