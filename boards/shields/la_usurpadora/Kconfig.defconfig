## boards/shields/la_usurpadora/Kconfig.defconfig
```kconfig
if SHIELD_LA_USURPADORA_DONGLE || SHIELD_LA_USURPADORA_LEFT || SHIELD_LA_USURPADORA_RIGHT
config ZMK_SPLIT
	default y
endif

if SHIELD_LA_USURPADORA_DONGLE
config ZMK_KEYBOARD_NAME
	default "La Usurpadora"
config ZMK_SPLIT_ROLE_CENTRAL
	default y
endif
```

## boards/shields/la_usurpadora/Kconfig.shield
```kconfig
config SHIELD_LA_USURPADORA_LEFT
    def_bool $(shields_list_contains,la_usurpadora_left)

config SHIELD_LA_USURPADORA_RIGHT
    def_bool $(shields_list_contains,la_usurpadora_right)

config SHIELD_LA_USURPADORA_DONGLE
    def_bool $(shields_list_contains,la_usurpadora_dongle)
```

## boards/shields/la_usurpadora_dongle/Kconfig.defconfig
```kconfig
if SHIELD_LA_USURPADORA_DONGLE

config ZMK_SPLIT
    default y

config ZMK_SPLIT_ROLE_CENTRAL
    default y

config ZMK_KEYBOARD_NAME
    default "La Usurpadora"

endif
```

## boards/shields/la_usurpadora_dongle/Kconfig.shield
```kconfig
config SHIELD_LA_USURPADORA_DONGLE
    def_bool $(shields_list_contains,la_usurpadora_dongle)
```
